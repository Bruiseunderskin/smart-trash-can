## esp32s3/ei_latency_probe/sdkconfig.defaults
```kconfig
CONFIG_TFLITE_PROBE_USE_ESP_NN=y
CONFIG_SPIRAM=y
CONFIG_SPIRAM_MODE_OCT=y
CONFIG_SPIRAM_SPEED_40M=y
CONFIG_PARTITION_TABLE_CUSTOM=y
CONFIG_PARTITION_TABLE_CUSTOM_FILENAME="partitions_probe.csv"
CONFIG_ESPTOOLPY_FLASHSIZE_16MB=y
```

## esp32s3/tflite_probe/main/Kconfig.projbuild
```kconfig
menu "TFLite probe"

config TFLITE_PROBE_USE_ESP_NN
    bool "Enable ESP-NN optimized kernels"
    default y
    help
        Compile the ESP-TFLite-Micro kernels with ESP-NN enabled. Disable this
        option to run the portable reference kernels for the A/B comparison.

config TFLITE_PROBE_MODEL_LABEL
    string "Embedded model label"
    default "unspecified"
    help
        Label printed in the monitor output. Keep it in sync with the model
        embedded as models/waste4_int8.tflite.

endmenu
```

## esp32s31/bringup/t2_camera/sdkconfig.defaults
```kconfig
CONFIG_IDF_TARGET="esp32s31"
CONFIG_ESPTOOLPY_FLASHMODE_QIO=y
CONFIG_ESPTOOLPY_FLASHSIZE_16MB=y
CONFIG_COMPILER_OPTIMIZATION_PERF=y
CONFIG_ESP_DEFAULT_CPU_FREQ_MHZ_320=y
CONFIG_SPIRAM=y
CONFIG_SPIRAM_MODE_OCT=y
CONFIG_SPIRAM_SPEED_200M=y
CONFIG_FREERTOS_HZ=1000
CONFIG_ESP_MAIN_TASK_STACK_SIZE=8192
CONFIG_CAMERA_OV3660=y
CONFIG_CAMERA_SC101IOT=y
CONFIG_CAM_CTRL_SPI_ENABLE=n
CONFIG_ESP_VIDEO_ENABLE_DVP_VIDEO_DEVICE=y
CONFIG_ESP_VIDEO_ENABLE_MIPI_CSI_VIDEO_DEVICE=n
CONFIG_ESP_VIDEO_ENABLE_SPI_VIDEO_DEVICE=n
CONFIG_ESP_VIDEO_ENABLE_USB_UVC_VIDEO_DEVICE=n
CONFIG_LV_BUILD_EXAMPLES=n
CONFIG_LV_BUILD_DEMOS=n
```

## esp32s31/bringup/t3_mic/sdkconfig.defaults
```kconfig
CONFIG_IDF_TARGET="esp32s31"
CONFIG_ESPTOOLPY_FLASHMODE_QIO=y
CONFIG_ESPTOOLPY_FLASHSIZE_16MB=y
CONFIG_COMPILER_OPTIMIZATION_PERF=y
CONFIG_ESP_DEFAULT_CPU_FREQ_MHZ_320=y
CONFIG_SPIRAM=y
CONFIG_SPIRAM_MODE_OCT=y
CONFIG_SPIRAM_SPEED_200M=y
CONFIG_FREERTOS_HZ=1000
CONFIG_ESP_MAIN_TASK_STACK_SIZE=8192
CONFIG_CODEC_ES8389_SUPPORT=y
CONFIG_LV_BUILD_EXAMPLES=n
CONFIG_LV_BUILD_DEMOS=n
```

## firmware/esp32s3/ei_latency_probe/main/Kconfig.projbuild
```kconfig
menu "TFLite probe"

config TFLITE_PROBE_USE_ESP_NN
    bool "Enable ESP-NN optimized kernels"
    default y
    help
        Compile the ESP-TFLite-Micro kernels with ESP-NN enabled. Disable this
        option to run the portable reference kernels for the A/B comparison.

endmenu
```

## firmware/esp32s3/node/main/Kconfig.projbuild
```kconfig
menu "STC node"

    menu "Servo pins (one GPIO per lid)"

        config STC_SERVO_GPIO_0
            int "Servo GPIO for bin 0 (recyclable)"
            range 0 48
            default 4

        config STC_SERVO_GPIO_1
            int "Servo GPIO for bin 1 (food)"
            range 0 48
            default 5

        config STC_SERVO_GPIO_2
            int "Servo GPIO for bin 2 (hazardous)"
            range 0 48
            default 6

        config STC_SERVO_GPIO_3
            int "Servo GPIO for bin 3 (other)"
            range 0 48
            default 7

        config STC_SERVO_CLOSED_US
            int "Closed pulse width (us)"
            range 500 2500
            default 1000

        config STC_SERVO_OPEN_US
            int "Open pulse width (us)"
            range 500 2500
            default 1500

    endmenu

    menu "TOF050C XSHUT pins"

        config STC_TOF_XSHUT_GPIO_0
            int "XSHUT GPIO for bin 0"
            range 0 48
            default 15

        config STC_TOF_XSHUT_GPIO_1
            int "XSHUT GPIO for bin 1"
            range 0 48
            default 16

        config STC_TOF_XSHUT_GPIO_2
            int "XSHUT GPIO for bin 2"
            range 0 48
            default 17

        config STC_TOF_XSHUT_GPIO_3
            int "XSHUT GPIO for bin 3"
            range 0 48
            default 18

    endmenu

    config STC_NOW_CHANNEL
        int "Wi-Fi channel used by ESP-NOW"
        range 1 13
        default 1

endmenu
```
